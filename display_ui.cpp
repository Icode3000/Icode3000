#include "display_ui.h"
#include <U8g2lib.h>
#include <Wire.h>
#include <freertos/FreeRTOS.h>
#include <freertos/task.h>
#include <freertos/semphr.h>
#include <qrcode.h>
#include "config.h"

// 1.3" 128x64 I2C OLEDs are almost always SH1106 controllers.
// If yours turns out to be SSD1306, swap this line for:
//   U8G2_SSD1306_128X64_NONAME_F_HW_I2C u8g2(U8G2_R0, U8X8_PIN_NONE);
U8G2_SH1106_128X64_NONAME_F_HW_I2C u8g2(U8G2_R0, U8X8_PIN_NONE);

#define ART_SIZE 64                  // animation area, left side of screen
#define TEXT_X   ART_SIZE            // text/controls column starts right where the art area ends
#define TEXT_W   (128 - TEXT_X)      // available width for text on the right (64px)
#define FRAME_WIDTH  128
#define FRAME_HEIGHT 64
#define FRAME_COUNT 28
#define FRAME_DELAY_MS 100
#define FRAME_BYTES (FRAME_WIDTH * FRAME_HEIGHT / 8)  // 1024 for the original 128x64 frames
#define ANIM_X (-34)  // shifts the animation 2px further left

static String trackName = "", trackArtist = "";
static bool isPlaying = false;
static int nameOffset = 0, artistOffset = 0;
static int animFrame = 0;
static unsigned long lastAnimMs = 0;
static unsigned long lastScrollMs = 0;
static bool forceRedraw = true;
static bool idleMode = false;

// ---- Device picker state ----
#define MAX_DEVICE_LIST 8
static String deviceListNames[MAX_DEVICE_LIST + 1];  // +1 for the "Back" row
static int deviceListRealCount = 0;                  // real devices, NOT counting "Back"
static int deviceListActiveIdx = -1;
static int deviceListSelIdx = 0;
static bool deviceListMode = false;

// ---- Liked Songs picker state ----
#define MAX_SONG_LIST 15
static String songListNames[MAX_SONG_LIST + 1];  // +1 for the "Back" row
static int songListRealCount = 0;                // real songs, NOT counting "Back"
static int songListSelIdx = 0;
static bool songListMode = false;

static SemaphoreHandle_t displayMutex = nullptr;
static TaskHandle_t displayTaskHandle = nullptr;
static void displayTask(void *parameter);

// Placeholder status values until the real WiFi/battery logic is wired in.
// Call displaySetStatus() any time to update them.
static int wifiBars = 3;       // 0-4
static int batteryPercent = 100; // 0-100

// Only ONE decompressed animation frame is ever held in RAM at a time
// (1024 bytes), regardless of how many frames exist in flash.
static uint8_t frameBuf[FRAME_BYTES];

// Original animation: 28 exact 128x64 frames from the standalone Music Playing Code.
// Frames are PackBits-compressed in PROGMEM; only the current frame is decompressed to RAM.
static const uint16_t frame_offsets[FRAME_COUNT] PROGMEM = {
  0, 564, 1128, 1688, 2240, 2786, 3324, 3868, 4409, 4954, 5513, 6077, 6641, 7205, 7769, 8333, 8897, 9459, 10013, 10558, 11089, 11622, 12165, 12723, 13287, 13851, 14415, 14979
};
static const uint16_t frame_lengths[FRAME_COUNT] PROGMEM = {
  564, 564, 560, 552, 546, 538, 544, 541, 545, 559, 564, 564, 564, 564, 564, 564, 562, 554, 545, 531, 533, 543, 558, 564, 564, 564, 564, 564
};
static const uint8_t frame_data[15543] PROGMEM = {
  0xCA, 0x00, 0x01, 0x7F, 0xFE, 0xF4, 0x00, 0x03, 0x07, 0xFF, 0xFF, 0xE0, 0xF5, 0x00, 0x03, 0x1F,
  0xE0, 0x07, 0xF8, 0xF5, 0x00, 0x03, 0x7E, 0x00, 0x00, 0x7E, 0xF5, 0x00, 0x03, 0xF8, 0x00, 0x00,
  0x7F, 0xF6, 0x00, 0x05, 0x01, 0xE0, 0x00, 0x00, 0x67, 0x80, 0xF7, 0x00, 0x05, 0x07, 0x80, 0x00,
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  0xF4, 0x00, 0x01, 0x7F, 0xFE, 0xCA, 0x00
};

// ---- PackBits-style RLE decoder (unchanged) ----
// header < 128:  (header + 1) literal bytes follow, copy verbatim
// header >= 128: (257 - header) repeats of the single byte that follows
static void packbitsDecode(const uint8_t *src, uint16_t srcLen, uint8_t *dst, uint16_t dstLen) {
  uint16_t si = 0, di = 0;
  while (si < srcLen && di < dstLen) {
    uint8_t header = pgm_read_byte(src + si++);
    if (header < 128) {
      uint8_t count = header + 1;
      for (uint8_t k = 0; k < count && di < dstLen && si < srcLen; k++) {
        dst[di++] = pgm_read_byte(src + si++);
      }
    } else {
      uint16_t count = 257 - header;
      uint8_t val = pgm_read_byte(src + si++);
      for (uint16_t k = 0; k < count && di < dstLen; k++) {
        dst[di++] = val;
      }
    }
  }
}

static void loadFrame(int idx) {
  uint16_t offset = pgm_read_word(&frame_offsets[idx]);
  uint16_t length = pgm_read_word(&frame_lengths[idx]);
  packbitsDecode(frame_data + offset, length, frameBuf, sizeof(frameBuf));

  // Your original frame data was authored for Adafruit_GFX's drawBitmap(),
  // which packs bits MSB-first per byte. U8g2's drawXBM() expects the XBM
  // convention (LSB-first per byte) instead — same bytes, opposite bit
  // order, so without this correction the image comes out scrambled
  // (effectively invisible). Reverse each byte to fix it.
  for (size_t i = 0; i < sizeof(frameBuf); i++) {
    uint8_t b = frameBuf[i];
    b = (b & 0xF0) >> 4 | (b & 0x0F) << 4;
    b = (b & 0xCC) >> 2 | (b & 0x33) << 2;
    b = (b & 0xAA) >> 1 | (b & 0x55) << 1;
    frameBuf[i] = b;
  }
}

void displayBegin() {
  Wire.begin(OLED_SDA, OLED_SCL);
  u8g2.begin();
  u8g2.setBusClock(400000);

  // The OLED renderer runs in its own FreeRTOS task. This is important because
  // Spotify HTTPS polling can block the Arduino loop for hundreds of ms or more.
  // Keeping rendering independent means animation + text scrolling stay smooth.
  displayMutex = xSemaphoreCreateMutex();
  if (displayMutex) {
    xTaskCreatePinnedToCore(
      displayTask,
      "OLED_Render",
      8192,
      nullptr,
      1,
      &displayTaskHandle,
      0
    );
  }
}

// Diagnostic only — call once from setup() after displayBegin() and check
// the Serial Monitor. Tells us whether the animation data is actually
// present and non-blank, without needing to see the OLED itself.
void displayDebugAnimation() {
  if (displayMutex) xSemaphoreTake(displayMutex, portMAX_DELAY);

  Serial.println("=== Animation debug ===");
  Serial.print("FRAME_COUNT = ");
  Serial.println(FRAME_COUNT);
  Serial.print("frame_offsets[0] = ");
  Serial.print(pgm_read_word(&frame_offsets[0]));
  Serial.print(", frame_lengths[0] = ");
  Serial.println(pgm_read_word(&frame_lengths[0]));

  loadFrame(0);

  uint16_t nonZero = 0;
  for (size_t i = 0; i < sizeof(frameBuf); i++) {
    if (frameBuf[i]) nonZero++;
  }
  Serial.print("frameBuf: ");
  Serial.print(nonZero);
  Serial.print(" of ");
  Serial.print((unsigned)sizeof(frameBuf));
  Serial.println(" bytes non-zero (0 here means the frame data itself is blank)");

  Serial.print("First 16 decoded bytes: ");
  for (int i = 0; i < 16; i++) {
    Serial.print(frameBuf[i]);
    Serial.print(" ");
  }
  Serial.println();
  Serial.println("========================");

  if (displayMutex) xSemaphoreGive(displayMutex);
}

void displaySetStatus(int bars, int percent) {
  if (displayMutex) xSemaphoreTake(displayMutex, portMAX_DELAY);
  wifiBars = constrain(bars, 0, 4);
  batteryPercent = constrain(percent, 0, 100);
  forceRedraw = true;
  if (displayMutex) xSemaphoreGive(displayMutex);
}

// Draws `text` at (TEXT_X, y) using `font`. If it's wider than maxW it
// scrolls horizontally instead of getting clipped, wrapping around with a
// gap so it reads as a continuous loop. `offset` is advanced by the display
// task on a fixed timer, independent of animation rendering.
static void renderScrollLine(int y, const String &text, int &offset, const uint8_t *font, int maxW) {
  u8g2.setFont(font);
  int w = u8g2.getStrWidth(text.c_str());

  if (w <= maxW) {
    u8g2.drawStr(TEXT_X, y, text.c_str());
    offset = 0;
    return;
  }

  const int gap = 16;
  int total = w + gap;
  int drawX = TEXT_X - offset;

  u8g2.setClipWindow(TEXT_X, y - (u8g2.getAscent() - u8g2.getDescent()), 128, y + 2);
  u8g2.drawStr(drawX, y, text.c_str());
  u8g2.drawStr(drawX + total, y, text.c_str());
  u8g2.setMaxClipWindow();
}

// ---- Playback control icons (prev / play-pause / next) ----
static void drawTriangle(int cx, int cy, int r, bool pointRight) {
  if (pointRight) {
    u8g2.drawTriangle(cx - r, cy - r, cx - r, cy + r, cx + r, cy);
  } else {
    u8g2.drawTriangle(cx + r, cy - r, cx + r, cy + r, cx - r, cy);
  }
}

static void drawPauseBars(int cx, int cy, int r) {
  u8g2.drawBox(cx - r, cy - r, 4, r * 2);
  u8g2.drawBox(cx + r - 4, cy - r, 4, r * 2);
}

static void drawControlsRow() {
  const int r = 6;
  const int y = 55;
  int cx1 = TEXT_X + (128 - TEXT_X) / 6;
  int cx2 = TEXT_X + (128 - TEXT_X) / 2;
  int cx3 = TEXT_X + (128 - TEXT_X) * 5 / 6;

  drawTriangle(cx1, y, r, false);
  if (isPlaying) drawPauseBars(cx2, y, r);
  else           drawTriangle(cx2, y, r, true);
  drawTriangle(cx3, y, r, true);
}

// ---- Status bar (wifi bars + battery %) ----
static void drawWifiIcon(int x, int yBase, int bars) {
  for (int i = 0; i < 4; i++) {
    int barH = 2 + i * 2;
    int bx = x + i * 3;
    if (i < bars) u8g2.drawBox(bx, yBase - barH, 2, barH);
    else          u8g2.drawFrame(bx, yBase - barH, 2, barH);
  }
}

static void drawBatteryIcon(int x, int y, int percent) {
  const int w = 14, h = 7, nub = 2;
  u8g2.drawFrame(x, y, w, h);
  u8g2.drawBox(x + w, y + 2, nub, h - 4);
  int fillW = (w - 2) * percent / 100;
  if (fillW > 0) u8g2.drawBox(x + 1, y + 1, fillW, h - 2);
}

static void drawStatusBar() {
  u8g2.setFont(u8g2_font_5x8_tf);
  char buf[6];
  snprintf(buf, sizeof(buf), "%d%%", batteryPercent);
  int textW = u8g2.getStrWidth(buf);

  const int batteryW = 14, wifiW = 10, gap = 3;
  int batteryX = 128 - batteryW - 2;
  int textX = batteryX - gap - textW;
  int wifiX = textX - gap - wifiW;

  drawWifiIcon(wifiX, 9, wifiBars);
  u8g2.drawStr(textX, 8, buf);
  drawBatteryIcon(batteryX, 1, batteryPercent);
}

// Picks the smallest QR version (1-6) whose byte-mode/ECC_LOW capacity
// fits the payload, so the code renders at the largest possible integer
// pixel scale within the 64x64 area instead of being stuck oversized-version/undersized-render.
static int pickQrVersion(size_t len) {
  static const int capacity[] = {17, 32, 53, 78, 106, 134};  // v1..v6, byte mode, ECC_LOW
  for (int v = 0; v < 6; v++) {
    if ((int)len <= capacity[v]) return v + 1;
  }
  return 6;
}

void displayShowWifiSetup(const String &qrPayload, const String &apSsid, const String &portalIp) {
  if (displayMutex) xSemaphoreTake(displayMutex, portMAX_DELAY);

  int version = pickQrVersion(qrPayload.length());
  QRCode qrcode;
  uint8_t qrcodeData[qrcode_getBufferSize(6)];  // sized for the largest version we ever pick
  qrcode_initText(&qrcode, qrcodeData, version, ECC_LOW, qrPayload.c_str());

  int n = qrcode.size;
  int scale = 64 / n;             // largest integer scale that still fits the 64x64 area
  if (scale < 1) scale = 1;
  int qrPx = n * scale;
  int qx = (64 - qrPx) / 2;   // centered in the left 64px half
  int qy = (64 - qrPx) / 2;

  u8g2.clearBuffer();
  for (int y = 0; y < n; y++) {
    for (int x = 0; x < n; x++) {
      if (qrcode_getModule(&qrcode, x, y)) {
        u8g2.drawBox(qx + x * scale, qy + y * scale, scale, scale);
      }
    }
  }

  u8g2.setFont(u8g2_font_6x10_tf);
  u8g2.drawStr(66, 10, "Scan to");
  u8g2.drawStr(66, 22, "set up WiFi");
  u8g2.setFont(u8g2_font_5x8_tf);
  u8g2.drawStr(66, 36, "or join AP:");
  u8g2.drawStr(66, 46, apSsid.c_str());
  u8g2.drawStr(66, 58, portalIp.c_str());

  u8g2.sendBuffer();

  if (displayMutex) xSemaphoreGive(displayMutex);
}

// The idle "Spotify logo + starfield" image, 128x64, decoded from the
// standalone OLED Display Animation Maker export you provided. Authored
// for Adafruit_GFX's drawBitmap() (MSB-first bits); reversed at load time
// to match u8g2's drawXBM() (LSB-first / XBM convention) — same fix as
// the disk animation above.
static const uint8_t idle_frame_data[1024] PROGMEM = {
  0x00, 0x00, 0x00, 0x00, 0x00, 0x00, 0x00, 0x00, 0x00, 0x00, 0x00, 0x00, 0x00, 0x00, 0x00, 0x00,
  0x00, 0x00, 0x00, 0x00, 0x00, 0x00, 0x00, 0x00, 0x00, 0x00, 0x00, 0x00, 0x00, 0x00, 0x00, 0x00,
  0x40, 0x00, 0x00, 0x00, 0x00, 0x00, 0x80, 0x00, 0x40, 0x00, 0x02, 0x00, 0x00, 0x00, 0x00, 0x18,
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  0x00, 0x00, 0x00, 0x00, 0x00, 0x00, 0x00, 0x00, 0x00, 0x00, 0x00, 0x00, 0x00, 0x00, 0x00, 0x00
};

static void loadIdleImage() {
  for (size_t i = 0; i < sizeof(frameBuf); i++) {
    uint8_t b = pgm_read_byte(&idle_frame_data[i]);
    b = (b & 0xF0) >> 4 | (b & 0x0F) << 4;
    b = (b & 0xCC) >> 2 | (b & 0x33) << 2;
    b = (b & 0xAA) >> 1 | (b & 0x55) << 1;
    frameBuf[i] = b;
  }
}

// Spotify logo + starfield, shown after IDLE_TIMEOUT_MS of no playback.
// Spotify Connect device picker, shown on a play/pause long-press.
static void renderDeviceList() {
  const int lineH = 12;
  const int visibleRows = 4;
  int totalRows = deviceListRealCount + 1;  // +1 for "Back"

  int start = deviceListSelIdx - visibleRows / 2;
  if (start < 0) start = 0;
  if (start > totalRows - visibleRows) start = max(0, totalRows - visibleRows);

  u8g2.setFont(u8g2_font_6x10_tf);
  u8g2.drawStr(2, 10, "Play on device:");
  u8g2.drawHLine(0, 12, 128);

  for (int row = 0; row < visibleRows; row++) {
    int idx = start + row;
    if (idx >= totalRows) break;

    int y = 26 + row * lineH;
    bool selected = (idx == deviceListSelIdx);
    String label = deviceListNames[idx];
    if (idx == deviceListActiveIdx) label += " *";

    if (selected) {
      u8g2.drawBox(0, y - 9, 128, lineH);
      u8g2.setDrawColor(0);
      u8g2.drawStr(4, y, label.c_str());
      u8g2.setDrawColor(1);
    } else {
      u8g2.drawStr(4, y, label.c_str());
    }
  }
}

void displayShowDeviceList(const String *names, int count, int activeIndex) {
  if (displayMutex) xSemaphoreTake(displayMutex, portMAX_DELAY);

  int n = min(count, MAX_DEVICE_LIST);
  for (int i = 0; i < n; i++) deviceListNames[i] = names[i];
  deviceListNames[n] = "< Back";
  deviceListRealCount = n;
  deviceListActiveIdx = activeIndex;
  deviceListSelIdx = 0;
  deviceListMode = true;
  forceRedraw = true;

  if (displayMutex) xSemaphoreGive(displayMutex);
}

void displayDeviceListMove(int delta) {
  if (displayMutex) xSemaphoreTake(displayMutex, portMAX_DELAY);

  int totalRows = deviceListRealCount + 1;
  if (totalRows > 0) {
    deviceListSelIdx = ((deviceListSelIdx + delta) % totalRows + totalRows) % totalRows;
  }
  forceRedraw = true;

  if (displayMutex) xSemaphoreGive(displayMutex);
}

int displayDeviceListGetSelection() {
  return deviceListSelIdx;
}

void displayHideDeviceList() {
  if (displayMutex) xSemaphoreTake(displayMutex, portMAX_DELAY);
  deviceListMode = false;
  forceRedraw = true;
  if (displayMutex) xSemaphoreGive(displayMutex);
}

// Liked Songs picker — same layout/behavior pattern as the device picker.
static void renderSongList() {
  const int lineH = 12;
  const int visibleRows = 4;
  int totalRows = songListRealCount + 1;  // +1 for "Back"

  int start = songListSelIdx - visibleRows / 2;
  if (start < 0) start = 0;
  if (start > totalRows - visibleRows) start = max(0, totalRows - visibleRows);

  u8g2.setFont(u8g2_font_6x10_tf);
  u8g2.drawStr(2, 10, "Liked Songs:");
  u8g2.drawHLine(0, 12, 128);

  for (int row = 0; row < visibleRows; row++) {
    int idx = start + row;
    if (idx >= totalRows) break;

    int y = 26 + row * lineH;
    bool selected = (idx == songListSelIdx);
    const String &label = songListNames[idx];

    if (selected) {
      u8g2.drawBox(0, y - 9, 128, lineH);
      u8g2.setDrawColor(0);
      u8g2.drawStr(4, y, label.c_str());
      u8g2.setDrawColor(1);
    } else {
      u8g2.drawStr(4, y, label.c_str());
    }
  }
}

void displayShowSongList(const String *names, int count) {
  if (displayMutex) xSemaphoreTake(displayMutex, portMAX_DELAY);

  int n = min(count, MAX_SONG_LIST);
  for (int i = 0; i < n; i++) songListNames[i] = names[i];
  songListNames[n] = "< Back";
  songListRealCount = n;
  songListSelIdx = 0;
  songListMode = true;
  forceRedraw = true;

  if (displayMutex) xSemaphoreGive(displayMutex);
}

void displaySongListMove(int delta) {
  if (displayMutex) xSemaphoreTake(displayMutex, portMAX_DELAY);

  int totalRows = songListRealCount + 1;
  if (totalRows > 0) {
    songListSelIdx = ((songListSelIdx + delta) % totalRows + totalRows) % totalRows;
  }
  forceRedraw = true;

  if (displayMutex) xSemaphoreGive(displayMutex);
}

int displaySongListGetSelection() {
  return songListSelIdx;
}

void displayHideSongList() {
  if (displayMutex) xSemaphoreTake(displayMutex, portMAX_DELAY);
  songListMode = false;
  forceRedraw = true;
  if (displayMutex) xSemaphoreGive(displayMutex);
}

static void renderIdle() {
  loadIdleImage();
  u8g2.drawXBM(0, 0, 128, 64, frameBuf);
}

void displayShowIdle() {
  if (displayMutex) xSemaphoreTake(displayMutex, portMAX_DELAY);
  idleMode = true;
  forceRedraw = true;
  if (displayMutex) xSemaphoreGive(displayMutex);
}


static void render() {
  u8g2.clearBuffer();

  if (songListMode) {
    renderSongList();
    u8g2.sendBuffer();
    return;
  }

  if (deviceListMode) {
    renderDeviceList();
    u8g2.sendBuffer();
    return;
  }

  if (idleMode) {
    renderIdle();
    u8g2.sendBuffer();
    return;
  }

  if (trackName.length() > 0) {
    loadFrame(isPlaying ? animFrame : 0);
    u8g2.drawXBM(ANIM_X, 0, FRAME_WIDTH, FRAME_HEIGHT, frameBuf);
  }

  drawStatusBar();
  renderScrollLine(30, trackName, nameOffset, u8g2_font_logisoso18_tr, TEXT_W);
  renderScrollLine(44, trackArtist, artistOffset, u8g2_font_7x13_tf, TEXT_W);
  drawControlsRow();
  u8g2.sendBuffer();
}

void displayUpdate(const String &name, const String &artist, bool playing) {
  if (displayMutex) xSemaphoreTake(displayMutex, portMAX_DELAY);

  if (name != trackName) nameOffset = 0;
  if (artist != trackArtist) artistOffset = 0;
  if (playing != isPlaying) {
    animFrame = 0;
    lastAnimMs = millis();
  }
  if (playing) idleMode = false;  // resuming playback always cancels the idle screen

  trackName = name;
  trackArtist = artist;
  isPlaying = playing;
  forceRedraw = true;

  if (displayMutex) xSemaphoreGive(displayMutex);
}

void displayShowMessage(const String &line1, const String &line2) {
  if (displayMutex) xSemaphoreTake(displayMutex, portMAX_DELAY);
  u8g2.clearBuffer();
  u8g2.setFont(u8g2_font_6x10_tf);
  u8g2.drawStr(4, 30, line1.c_str());
  if (line2.length()) u8g2.drawStr(4, 45, line2.c_str());
  u8g2.sendBuffer();
  if (displayMutex) xSemaphoreGive(displayMutex);
}

// Dedicated OLED renderer. It wakes frequently but only sends a full frame
// when animation, scrolling, or a state/data change actually requires it.
static void displayTask(void *parameter) {
  (void)parameter;

  for (;;) {
    unsigned long now = millis();
    bool needsRedraw = false;

    if (displayMutex) xSemaphoreTake(displayMutex, portMAX_DELAY);

    if (isPlaying && now - lastAnimMs >= FRAME_DELAY_MS) {
      // Preserve the original 100 ms animation timing while catching up cleanly.
      lastAnimMs = now;
      animFrame = (animFrame + 1) % FRAME_COUNT;
      needsRedraw = true;
    }

    if (now - lastScrollMs >= 120) {
      lastScrollMs = now;

      u8g2.setFont(u8g2_font_logisoso18_tr);
      bool nameScrolls = u8g2.getStrWidth(trackName.c_str()) > TEXT_W;
      u8g2.setFont(u8g2_font_7x13_tf);
      bool artistScrolls = u8g2.getStrWidth(trackArtist.c_str()) > TEXT_W;

      if (nameScrolls) {
        int w = u8g2.getStrWidth(trackName.c_str());
        int total = w + 16;
        nameOffset = (nameOffset + 1) % total;
      } else {
        nameOffset = 0;
      }

      if (artistScrolls) {
        int w = u8g2.getStrWidth(trackArtist.c_str());
        int total = w + 16;
        artistOffset = (artistOffset + 1) % total;
      } else {
        artistOffset = 0;
      }

      if (nameScrolls || artistScrolls) needsRedraw = true;
    }

    if (forceRedraw) {
      forceRedraw = false;
      needsRedraw = true;
    }

    if (needsRedraw) render();

    if (displayMutex) xSemaphoreGive(displayMutex);

    // 5 ms scheduler granularity keeps timing smooth without busy-spinning.
    vTaskDelay(pdMS_TO_TICKS(5));
  }
}

// Kept for compatibility with the existing main sketch. Rendering is now
// independent of the Arduino loop, so Spotify HTTPS requests cannot freeze it.
void displayLoop() {
  // OLED rendering is handled by displayTask().
}
